/* Copyright (c) 2017, The Linux Foundation. All rights reserved.
 *
 * This program is free software; you can redistribute it and/or modify
 * it under the terms of the GNU General Public License version 2 and
 * only version 2 as published by the Free Software Foundation.
 *
 * This program is distributed in the hope that it will be useful,
 * but WITHOUT ANY WARRANTY; without even the implied warranty of
 * MERCHANTABILITY or FITNESS FOR A PARTICULAR PURPOSE.  See the
 * GNU General Public License for more details.
 */
/*
 * Copyright (C) 2018 Sony Mobile Communications Inc.
 *
 * This program is free software; you can redistribute it and/or modify
 * it under the terms of the GNU General Public License version 2, as
 * published by the Free Software Foundation.
 */

&mdss_mdp {
	/* Tianma ID2 */
	dsi_2: somc,2_panel {
		qcom,mdss-dsi-panel-name = "8";
		qcom,mdss-dsi-panel-type = "dsi_video_mode";
		qcom,mdss-dsi-panel-width = <1080>;
		qcom,mdss-dsi-panel-height = <2520>;
		qcom,mdss-dsi-bpp = <24>;
		qcom,mdss-dsi-h-back-porch = <40>;
		qcom,mdss-dsi-h-pulse-width = <26>;
		qcom,mdss-dsi-h-front-porch = <80>;
		qcom,mdss-dsi-v-back-porch = <35>;
		qcom,mdss-dsi-v-pulse-width = <2>;
		qcom,mdss-dsi-v-front-porch = <4>;
		qcom,mdss-pan-physical-width-dimension = <59>;
		qcom,mdss-pan-physical-height-dimension = <139>;
		qcom,mdss-dsi-panel-framerate = <60>;
		qcom,mdss-dsi-virtual-channel-id = <0>;
		qcom,mdss-dsi-stream = <0>;
		qcom,mdss-dsi-h-sync-skew = <0>;
		qcom,mdss-dsi-h-left-border = <0>;
		qcom,mdss-dsi-h-right-border = <0>;
		qcom,mdss-dsi-v-top-border = <0>;
		qcom,mdss-dsi-v-bottom-border = <0>;
		qcom,mdss-dsi-underflow-color = <0x0>;
		qcom,mdss-dsi-border-color = <0>;
		qcom,mdss-dsi-h-sync-pulse = <0>;
		qcom,mdss-dsi-traffic-mode = "burst_mode";
		qcom,mdss-dsi-bllp-eof-power-mode;
		qcom,mdss-dsi-bllp-power-mode;
		qcom,mdss-dsi-dma-trigger = "trigger_sw";
		qcom,mdss-dsi-mdp-trigger = "none";
		qcom,mdss-dsi-tx-eot-append;
		qcom,mdss-dsi-on-command = [
				15 01 00 00 00 00 02 35 00
				29 01 00 00 00 00 02 B0 00
				29 01 00 00 00 00 02 D6 00
				29 01 00 00 00 00 02 B7 51
				29 01 00 00 00 00 02 B0 03];
		qcom,mdss-dsi-post-panel-on-command = [
				05 01 00 00 00 00 01 29
				05 01 00 00 46 00 01 11];
		qcom,mdss-dsi-off-command = [
				05 01 00 00 00 00 01 28
				05 01 00 00 55 00 01 10];
		qcom,mdss-dsi-on-command-state = "dsi_lp_mode";
		qcom,mdss-dsi-off-command-state = "dsi_hs_mode";
		/*qcom,mdss-dsi-te-pin-select = <1>;*/
		/*qcom,mdss-dsi-wr-mem-start = <0x2c>;*/
		/*qcom,mdss-dsi-wr-mem-continue = <0x3c>;*/
		/*qcom,mdss-dsi-te-dcs-command = <1>;*/
		/*qcom,mdss-dsi-te-check-enable;*/
		/*qcom,mdss-dsi-te-using-te-pin;*/
		qcom,mdss-dsi-lane-0-state;
		qcom,mdss-dsi-lane-1-state;
		qcom,mdss-dsi-lane-2-state;
		qcom,mdss-dsi-lane-3-state;
		qcom,mdss-dsi-panel-timings-phy-v2 = [27 21 0A 0B 07 03 04 A0
				27 21 0A 0B 07 03 04 A0
				27 21 0A 0B 07 03 04 A0
				27 21 0A 0B 07 03 04 A0
				27 21 0A 0B 07 03 04 A0];
		qcom,mdss-dsi-t-clk-post = <0x0F>;
		qcom,mdss-dsi-t-clk-pre = <0x39>;

		qcom,panel-supply-entries = <&dsi_panel_pwr_supply_himiko_incell>;
		/*qcom,mdss-dsi-lp11-init;*/
		qcom,mdss-dsi-bl-min-level = <1>;
		qcom,mdss-dsi-bl-max-level = <4095>;
		qcom,mdss-brightness-max-level = <4095>;
		qcom,mdss-dsi-bl-pmic-control-type = "bl_ctrl_wled";

		qcom,mdss-dsi-panel-hdr-enabled;
		qcom,mdss-dsi-panel-hdr-color-primaries = <14500 15500 32000 17000 15500 30000 8000 3000>;
		qcom,mdss-dsi-panel-peak-brightness = <4200000>;
		qcom,mdss-dsi-panel-blackness-level = <3230>;

		qcom,mdss-dsi-reset-sequence = <1 20>;
		qcom,mdss-dsi-touch-reset-sequence = <1 5>;
		somc,pw-on-rst-seq = "after_power_on";

		qcom,mdss-dsi-panel-clockrate = <1130322960>;

		somc,lcd-id-adc = <1400000 1614000>;
		somc,mdss-dsi-master;
		somc,pw-off-rst-b-seq = <0 5>;
		somc,pw-wait-after-on-vdd = <0>;
		somc,pw-wait-after-on-vddio = <0>;
		somc,pw-wait-after-on-vsp = <0>;
		somc,pw-wait-after-on-vsn = <1>;
		somc,pw-wait-after-off-vdd = <0>;
		somc,pw-wait-after-off-vddio = <0>;
		somc,pw-wait-after-off-vsp = <10>;
		somc,pw-wait-after-off-vsn = <8>;
		somc,pw-wait-after-on-touch-avdd = <0>;
		somc,pw-wait-after-on-touch-vddio = <0>;
		somc,pw-wait-after-on-touch-reset = <1>;
		somc,pw-wait-after-on-touch-int-n = <5>;
		somc,pw-wait-after-off-touch-avdd = <0>;
		somc,pw-wait-after-off-touch-vddio = <0>;
		somc,pw-wait-after-off-touch-reset = <5>;
		somc,pw-wait-after-off-touch-int-n = <0>;
		somc,pw-down-period = <100>;

		/*somc,ewu-wait-after-touch-reset = <40>;*/

		/*somc,fps-mode-enable;*/
		somc,fps-mode-panel-mode = "dynamic_mode";

		somc,mdss-dsi-disp-on-in-hs = <0>;
		somc,mdss-dsi-wait-time-before-post-on-cmd = <0>;
	};

	/* AUO ID8 with video mode*/
	dsi_8: somc,8_panel {
		qcom,mdss-dsi-panel-name = "2";
		qcom,mdss-dsi-panel-type = "dsi_video_mode";
		qcom,mdss-dsi-panel-width = <1080>;
		qcom,mdss-dsi-panel-height = <2160>;
		qcom,mdss-dsi-bpp = <24>;
		qcom,mdss-dsi-h-back-porch = <12>;
		qcom,mdss-dsi-h-pulse-width = <8>;
		qcom,mdss-dsi-h-front-porch = <28>;
		qcom,mdss-dsi-v-back-porch = <8>;
		qcom,mdss-dsi-v-pulse-width = <8>;
		qcom,mdss-dsi-v-front-porch = <198>;
		qcom,mdss-pan-physical-width-dimension = <56>;
		qcom,mdss-pan-physical-height-dimension = <112>;
		qcom,mdss-dsi-panel-framerate = <60>;
		qcom,mdss-dsi-virtual-channel-id = <0>;
		qcom,mdss-dsi-stream = <0>;
		qcom,mdss-dsi-h-sync-skew = <0>;
		qcom,mdss-dsi-h-left-border = <0>;
		qcom,mdss-dsi-h-right-border = <0>;
		qcom,mdss-dsi-v-top-border = <0>;
		qcom,mdss-dsi-v-bottom-border = <0>;
		qcom,mdss-dsi-underflow-color = <0x0>;
		qcom,mdss-dsi-border-color = <0>;
		qcom,mdss-dsi-h-sync-pulse = <0>;
		qcom,mdss-dsi-traffic-mode = "burst_mode";
		qcom,mdss-dsi-bllp-eof-power-mode;
		qcom,mdss-dsi-bllp-power-mode;
		qcom,mdss-dsi-dma-trigger = "trigger_sw";
		qcom,mdss-dsi-mdp-trigger = "none";
		qcom,mdss-dsi-tx-eot-append;
		qcom,mdss-dsi-on-command = [
				15 01 00 00 00 00 02 35 00
				39 01 00 00 00 00 05 2A 00 00 04 37
				39 01 00 00 00 00 05 2B 00 00 08 6F];
		qcom,mdss-dsi-post-panel-on-command = [
				05 01 00 00 00 00 01 29
				05 01 00 00 46 00 01 11];
		qcom,mdss-dsi-off-command = [
				05 01 00 00 00 00 01 28
				05 01 00 00 55 00 01 10];
		qcom,mdss-dsi-on-command-state = "dsi_lp_mode";
		qcom,mdss-dsi-off-command-state = "dsi_hs_mode";
		/*qcom,mdss-dsi-te-pin-select = <1>;*/
		/*qcom,mdss-dsi-wr-mem-start = <0x2c>;*/
		/*qcom,mdss-dsi-wr-mem-continue = <0x3c>;*/
		/*qcom,mdss-dsi-te-dcs-command = <1>;*/
		/*qcom,mdss-dsi-te-check-enable;*/
		/*qcom,mdss-dsi-te-using-te-pin;*/
		qcom,mdss-dsi-lane-0-state;
		qcom,mdss-dsi-lane-1-state;
		qcom,mdss-dsi-lane-2-state;
		qcom,mdss-dsi-lane-3-state;
		qcom,mdss-dsi-panel-timings-phy-v2 = [25 20 08 0A 06 03 04 A0
				25 20 08 0A 06 03 04 A0
				25 20 08 0A 06 03 04 A0
				25 20 08 0A 06 03 04 A0
				25 1D 08 0A 06 03 04 A0];
		qcom,mdss-dsi-t-clk-post = <0x0E>;
		qcom,mdss-dsi-t-clk-pre = <0x33>;

		qcom,panel-supply-entries = <&dsi_panel_pwr_supply_himiko_incell>;
		/*qcom,mdss-dsi-lp11-init;*/
		qcom,mdss-dsi-bl-min-level = <1>;
		qcom,mdss-dsi-bl-max-level = <4095>;
		qcom,mdss-brightness-max-level = <4095>;
		qcom,mdss-dsi-bl-pmic-control-type = "bl_ctrl_wled";

		qcom,mdss-dsi-panel-hdr-enabled;
		qcom,mdss-dsi-panel-hdr-color-primaries = <14500 15500 32000 17000 15500 30000 8000 3000>;
		qcom,mdss-dsi-panel-peak-brightness = <4200000>;
		qcom,mdss-dsi-panel-blackness-level = <3230>;

		qcom,mdss-dsi-reset-sequence = <1 0>;
		qcom,mdss-dsi-touch-reset-sequence = <1 5>;
		somc,pw-on-rst-seq = "before_power_on";

		qcom,mdss-dsi-panel-clockrate = <958000000>;

		somc,lcd-id-adc = <215000 256000>;
		somc,mdss-dsi-master;
		somc,pw-off-rst-b-seq = <0 5>;
		somc,pw-wait-after-on-vdd = <0>;
		somc,pw-wait-after-on-vddio = <0>;
		somc,pw-wait-after-on-vsp = <0>;
		somc,pw-wait-after-on-vsn = <15>;
		somc,pw-wait-after-off-vdd = <0>;
		somc,pw-wait-after-off-vddio = <0>;
		somc,pw-wait-after-off-vsp = <10>;
		somc,pw-wait-after-off-vsn = <8>;
		somc,pw-wait-after-on-touch-avdd = <0>;
		somc,pw-wait-after-on-touch-vddio = <0>;
		somc,pw-wait-after-on-touch-reset = <5>;
		somc,pw-wait-after-on-touch-int-n = <5>;
		somc,pw-wait-after-off-touch-avdd = <0>;
		somc,pw-wait-after-off-touch-vddio = <0>;
		somc,pw-wait-after-off-touch-reset = <5>;
		somc,pw-wait-after-off-touch-int-n = <0>;
		somc,pw-down-period = <100>;

		/*somc,ewu-wait-after-touch-reset = <40>;*/

		/*somc,fps-mode-enable;*/
		somc,fps-mode-panel-mode = "dynamic_mode";

		somc,mdss-dsi-disp-on-in-hs = <0>;
		somc,mdss-dsi-wait-time-before-post-on-cmd = <0>;
	};


	/* Tianma */
	dsi_default_panel: somc,default_cmd_panel {
		qcom,mdss-dsi-panel-name = "1";
		qcom,mdss-dsi-panel-type = "dsi_video_mode";
		qcom,mdss-dsi-panel-width = <1080>;
		qcom,mdss-dsi-panel-height = <2520>;
		qcom,mdss-dsi-bpp = <24>;
		qcom,mdss-dsi-h-back-porch = <40>;
		qcom,mdss-dsi-h-pulse-width = <26>;
		qcom,mdss-dsi-h-front-porch = <80>;
		qcom,mdss-dsi-v-back-porch = <2>;
		qcom,mdss-dsi-v-pulse-width = <35>;
		qcom,mdss-dsi-v-front-porch = <4>;
		qcom,mdss-pan-physical-width-dimension = <59>;
		qcom,mdss-pan-physical-height-dimension = <139>;
		qcom,mdss-dsi-panel-framerate = <60>;
		qcom,mdss-dsi-virtual-channel-id = <0>;
		qcom,mdss-dsi-stream = <0>;
		qcom,mdss-dsi-h-sync-skew = <0>;
		qcom,mdss-dsi-h-left-border = <0>;
		qcom,mdss-dsi-h-right-border = <0>;
		qcom,mdss-dsi-v-top-border = <0>;
		qcom,mdss-dsi-v-bottom-border = <0>;
		qcom,mdss-dsi-underflow-color = <0x0>;
		qcom,mdss-dsi-border-color = <0>;
		qcom,mdss-dsi-h-sync-pulse = <0>;
		qcom,mdss-dsi-traffic-mode = "burst_mode";
		qcom,mdss-dsi-bllp-eof-power-mode;
		qcom,mdss-dsi-bllp-power-mode;
		qcom,mdss-dsi-dma-trigger = "trigger_sw";
		qcom,mdss-dsi-mdp-trigger = "none";
		qcom,mdss-dsi-tx-eot-append;
		qcom,mdss-dsi-on-command = [
				15 01 00 00 00 00 02 35 00
				29 01 00 00 00 00 02 B0 00
				29 01 00 00 00 00 02 D6 00
				29 01 00 00 00 00 02 B7 51
				29 01 00 00 00 00 02 B0 03];
		qcom,mdss-dsi-post-panel-on-command = [
				05 01 00 00 00 00 01 29
				05 01 00 00 46 00 01 11];
		qcom,mdss-dsi-off-command = [
				05 01 00 00 00 00 01 28
				05 01 00 00 55 00 01 10];
		qcom,mdss-dsi-on-command-state = "dsi_lp_mode";
		qcom,mdss-dsi-off-command-state = "dsi_hs_mode";
		/*qcom,mdss-dsi-te-pin-select = <1>;*/
		/*qcom,mdss-dsi-wr-mem-start = <0x2c>;*/
		/*qcom,mdss-dsi-wr-mem-continue = <0x3c>;*/
		/*qcom,mdss-dsi-te-dcs-command = <1>;*/
		/*qcom,mdss-dsi-te-check-enable;*/
		/*qcom,mdss-dsi-te-using-te-pin;*/
		qcom,mdss-dsi-lane-0-state;
		qcom,mdss-dsi-lane-1-state;
		qcom,mdss-dsi-lane-2-state;
		qcom,mdss-dsi-lane-3-state;
		qcom,mdss-dsi-panel-timings-phy-v2 = [27 21 0A 0B 07 03 04 A0
				27 21 0A 0B 07 03 04 A0
				27 21 0A 0B 07 03 04 A0
				27 21 0A 0B 07 03 04 A0
				27 21 0A 0B 07 03 04 A0];
		qcom,mdss-dsi-t-clk-post = <0x0F>;
		qcom,mdss-dsi-t-clk-pre = <0x39>;

		qcom,panel-supply-entries = <&dsi_panel_pwr_supply_himiko_incell>;
		/*qcom,mdss-dsi-lp11-init;*/
		qcom,mdss-dsi-bl-min-level = <1>;
		qcom,mdss-dsi-bl-max-level = <4095>;
		qcom,mdss-brightness-max-level = <4095>;
		qcom,mdss-dsi-bl-pmic-control-type = "bl_ctrl_wled";

		qcom,mdss-dsi-panel-hdr-enabled;
		qcom,mdss-dsi-panel-hdr-color-primaries = <14500 15500 32000 17000 15500 30000 8000 3000>;
		qcom,mdss-dsi-panel-peak-brightness = <4200000>;
		qcom,mdss-dsi-panel-blackness-level = <3230>;

		qcom,mdss-dsi-reset-sequence = <1 0>;
		qcom,mdss-dsi-touch-reset-sequence = <1 5>;
		somc,pw-on-rst-seq = "before_power_on";

		qcom,mdss-dsi-panel-clockrate = <1130322960>;

		somc,lcd-id-adc = <1705000 1899000>;
		somc,mdss-dsi-master;
		somc,pw-off-rst-b-seq = <0 5>;
		somc,pw-wait-after-on-vdd = <0>;
		somc,pw-wait-after-on-vddio = <0>;
		somc,pw-wait-after-on-vsp = <0>;
		somc,pw-wait-after-on-vsn = <15>;
		somc,pw-wait-after-off-vdd = <0>;
		somc,pw-wait-after-off-vddio = <0>;
		somc,pw-wait-after-off-vsp = <10>;
		somc,pw-wait-after-off-vsn = <8>;
		somc,pw-wait-after-on-touch-avdd = <0>;
		somc,pw-wait-after-on-touch-vddio = <0>;
		somc,pw-wait-after-on-touch-reset = <5>;
		somc,pw-wait-after-on-touch-int-n = <5>;
		somc,pw-wait-after-off-touch-avdd = <0>;
		somc,pw-wait-after-off-touch-vddio = <0>;
		somc,pw-wait-after-off-touch-reset = <5>;
		somc,pw-wait-after-off-touch-int-n = <0>;
		somc,pw-down-period = <100>;

		/*somc,ewu-wait-after-touch-reset = <40>;*/

		/*somc,fps-mode-enable;*/
		somc,fps-mode-panel-mode = "dynamic_mode";

		somc,mdss-dsi-disp-on-in-hs = <0>;
		somc,mdss-dsi-wait-time-before-post-on-cmd = <0>;
	};
};

#include "dsi-panel-himiko-id2_pcc.dtsi"
#include "dsi-panel-himiko-id8_pcc.dtsi"
